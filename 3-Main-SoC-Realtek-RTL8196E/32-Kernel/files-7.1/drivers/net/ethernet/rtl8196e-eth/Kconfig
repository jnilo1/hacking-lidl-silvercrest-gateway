## 3-Main-SoC-Realtek-RTL8196E/32-Kernel/files-7.1/drivers/net/ethernet/rtl8196e-eth/Kconfig
```kconfig
# SPDX-License-Identifier: GPL-2.0
config RTL8196E_ETH
	tristate "Realtek RTL8196E Ethernet (new, recommended)"
	depends on MIPS && OF
	help
	  Clean-room RTL8196E Ethernet driver: single-port, NAPI, zero-copy
	  RX/TX. Replaces the legacy rtl819x SDK port with maintainable code.

	  Delivers ~94 Mbps TCP RX and ~73 Mbps TCP TX on the Lexra RLX4181
	  (RTL8196E at 400 MHz). Configured via devicetree (interface@0 node).

config RTL8196E_ETH_DEBUG
	bool "RTL8196E Ethernet fault-injection hooks (issue #99 validation)"
	depends on RTL8196E_ETH
	help
	  Compile in debug-only fault-injection hooks used to validate the
	  issue #99 soft-lockup recovery path on the bench:

	    rtl8196e_force_dropflood - force the RX poll to drop the next N
	      consumed descriptors, reproducing the field drop-flood storm so
	      the bounded poll (return-under-saturation) can be exercised.
	    rtl8196e_force_stall - present N budget-saturating zero-delivery
	      polls to the wrapper, deterministically driving the stall
	      detector into the switch-core deep-reset escalation.

	  Both are module parameters under
	  /sys/module/rtl8196e_eth/parameters/ and auto-expire (countdowns).

	  This must NEVER be enabled in a shipped image. Say N.
```

## 3-Main-SoC-Realtek-RTL8196E/32-Kernel/linux-5.10.246-rtl8196e/drivers/net/ethernet/rtl8196e-eth/Kconfig
```kconfig
# SPDX-License-Identifier: GPL-2.0
config RTL8196E_ETH
	tristate "Realtek RTL8196E minimal Ethernet (new)"
	depends on MIPS && OF
	help
	  New minimal RTL8196E Ethernet driver (single-port, zero-copy).
	  Currently a skeleton; not functional yet.

config RTL8196E_IMEM
	bool "Use on-chip I-MEM for hot-path functions"
	depends on RTL8196E_ETH
	default n
	help
	  Place rtl8196e_ring_rx_poll() in the RTL8196E 16 KB on-chip
	  instruction SRAM (I-MEM), giving zero wait-state instruction
	  fetches on the NAPI RX hot path.

	  Also compiles rx_poll with the MIPS16e ISA extension (16-bit
	  compressed instructions, ~30% smaller code), which is applied
	  unconditionally via __MIPS16 regardless of this option.

	  Requires platform-level I-MEM initialisation (_imem_dmem_init)
	  which programs the Lexra COP3 coprocessor at boot.

	  Say Y to enable. Safe to leave N; MIPS16e is always active.
```
