## 3-Main-SoC-Realtek-RTL8196E/32-Kernel/files/arch/mips/realtek/Kconfig
```kconfig
# SPDX-License-Identifier: GPL-2.0
if REALTEK

choice
	prompt "Realtek SoC selection"
	default SOC_RTL8196E
	help
	  Select Realtek SoC type.

	config SOC_RTL8196E
		bool "RTL8196E"
		select USE_GENERIC_EARLY_PRINTK_8250
		select SYS_SUPPORTS_BIG_ENDIAN
		select SYS_HAS_CPU_RLX4181
		select HW_HAS_PCI
		select GPIOLIB
		select GPIO_GENERIC
		select GPIOLIB_IRQCHIP
		select RTL819X_INTC
		select CLKSRC_RTL819X
		select SYS_SUPPORTS_ZBOOT

endchoice

choice
	prompt "Devicetree selection"
	default DTB_RTK_NONE
	help
	  Select the devicetree.

	config DTB_RTK_NONE
		bool "None"

	config DTB_RTL8196E_GEN
		bool "RTL8196E Lidl Gateway"
		depends on SOC_RTL8196E
		select BUILTIN_DTB

endchoice

config RTL8196E_IMEM
	bool "Use on-chip I-MEM for hot-path functions"
	depends on SOC_RTL8196E
	default y
	help
	  Place hot-path functions (IRQ dispatch, NAPI poll, TX submit,
	  DMA cache ops) in the 16 KB on-chip instruction SRAM (I-MEM)
	  for zero wait-state instruction fetch.  The RLX4181 COP3
	  coprocessor maps a 16 KB SDRAM region to the on-chip SRAM
	  at boot time via IRAM Fill.

	  If unsure, say Y.

endif
```

## 3-Main-SoC-Realtek-RTL8196E/32-Kernel/files/drivers/net/ethernet/rtl8196e-eth/Kconfig
```kconfig
# SPDX-License-Identifier: GPL-2.0
config RTL8196E_ETH
	tristate "Realtek RTL8196E Ethernet (new, recommended)"
	depends on MIPS && OF
	depends on !RTL819X
	help
	  Clean-room RTL8196E Ethernet driver: single-port, NAPI, zero-copy
	  RX/TX. Replaces the legacy rtl819x SDK port with maintainable code.

	  Delivers ~91 Mbps TCP RX and ~44 Mbps TCP TX on the Lexra RLX4181
	  (RTL8196E at 400 MHz). Configured via devicetree (interface@0 node).
```

## 3-Main-SoC-Realtek-RTL8196E/32-Kernel/files/drivers/net/ethernet/rtl819x/Kconfig
```kconfig
#
# Realtek RTL819x Ethernet driver configuration
#

config RTL819X
	tristate "Realtek RTL819x Ethernet support (legacy)"
	depends on REALTEK || COMPILE_TEST
	select PHYLIB
	select NET_CORE
	help
	  This driver supports the integrated Ethernet controller found on
	  Realtek RTL8196E and similar SoCs. This is a simplified single-port
	  driver derived from the Linux 2.6.30 SDK driver.

	  The driver supports:
	  - Single physical Ethernet port (port 4)
	  - Hardware checksum offload
	  - VLAN support
	  - Integrated 6-port switch

	  To compile this driver as a module, choose M here: the module
	  will be called rtl819x.
```
